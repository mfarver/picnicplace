## panel/firmware/main/Kconfig.projbuild
```kconfig
menu "PicnicPlace panel"

    choice PANEL_LINK
        prompt "Link to the core"
        default PANEL_LINK_USB
        help
            Where the panel exchanges its JSON messages with the core.

        config PANEL_LINK_UART
            bool "UART0, through the board's USB-to-UART port (for development)"
        config PANEL_LINK_USB
            bool "Native USB, as a USB serial device (the I/O expander selects USB)"
    endchoice

    choice PANEL_ORIENTATION
        prompt "Orientation"
        default PANEL_PORTRAIT_RIGHT_UP
        help
            How the screen is mounted. The board's long edges are its left and right in
            portrait.

        config PANEL_PORTRAIT_RIGHT_UP
            bool "Portrait, the board's right edge (in landscape) at the top"
        config PANEL_PORTRAIT_LEFT_UP
            bool "Portrait, the board's left edge (in landscape) at the top"
        config PANEL_LANDSCAPE
            bool "Landscape"
    endchoice

endmenu
```
